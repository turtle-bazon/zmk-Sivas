## boards/shields/Sivas/Kconfig.defconfig
```kconfig
# Copyright (c) 2020 The ZMK Contributors
# SPDX-License-Identifier: MIT

if SHIELD_Sivas

config ZMK_KEYBOARD_NAME
    default "Sivas"

config ZMK_SPLIT
    default n
endif
```

## boards/shields/Sivas/Kconfig.shield
```kconfig
# Copyright (c) 2020 The ZMK Contributors
# SPDX-License-Identifier: MIT

config SHIELD_Sivas
    def_bool $(shields_list_contains,Sivas)
    select ZMK_BOARD_COMPAT
```

## config/west.yml
```yaml
manifest:
  remotes:
    - name: zmkfirmware
      url-base: https://github.com/zmkfirmware
    - name: inpudiy
      url-base: https://github.com/inpudiy
  projects:
    - name: zmk
      remote: zmkfirmware
      revision: main
      import: app/west.yml
    - name: zmk-waveshare_rp2040_zero
      remote: inpudiy
      revision: main
      import: config/west.yml
  self:
    path: config
```
